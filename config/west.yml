## config/west.yml
```yaml
manifest:
  defaults:
    revision: v0.3
  remotes:
    - name: zmkfirmware
      url-base: https://github.com/zmkfirmware
    - name: mechboards
      url-base: https://github.com/MechboardsLTD
  projects:
    - name: zmk
      remote: zmkfirmware
      import: app/west.yml
    - name: zmk-module
      remote: mechboards
      revision: nv_gem
  self:
    path: config
```
